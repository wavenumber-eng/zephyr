## subsys/usb/device_next/class/Kconfig.midi2
```kconfig
# Copyright (c) 2024 Titouan Christophe
#
# SPDX-License-Identifier: Apache-2.0

config USBD_MIDI2_CLASS
	bool "USB MIDI 2.0 class support [EXPERIMENTAL]"
	select RING_BUFFER
	help
	  Enable the USB MIDI 2.0 device class support.

if USBD_MIDI2_CLASS

config USBD_MIDI2_TX_QUEUE_SIZE
	int "MIDI 2.0 class transmit queue size"
	default 64
	help
	  Size of the transmit ring buffer. This buffer is used to store
	  MIDI messages before they are sent to the USB host.
	  The default is 64 bytes.

config USBD_MIDI2_BUF_POOL_COUNT
	int "MIDI 2.0 class UDC buffer pool count"
	default 2
	range 2 32
	help
	  Number of USB device controller buffers reserved for the MIDI 2.0
	  class instance. Increase this when composite CDC + MIDI traffic or
	  bursty MIDI sources exhaust the default transmit buffers.

module = USBD_MIDI2
module-str = usbd midi2
source "subsys/logging/Kconfig.template.log_config"

endif
```
